## drivers/input/touchscreen/oppo_touchscreen/Kconfig
```kconfig
config TOUCHPANEL_MTK_PLATFORM
	bool "OPPO platform tp module used"
	help
	  Say Y here if you have mtk-platform.

config TOUCHPANEL_OPPO
	bool "OPPO tp module"
	help
	  Say Y here if you have touchscreen module.

config TOUCHPANEL_SYNAPTICS
#	default y
	bool "TP Synaptics_IC enable or not for OPPO"
	---help---
	say Y to enable driver for Touchpanel using Synaptics_IC

config TOUCHPANEL_NOVA
#	default y
	bool "TP Nova_IC enable or not for OPPO"
	---help---
	say Y to enable driver for Touchpanel using NOVATECK_IC
config TOUCHPANEL_HIMAX
#	default y
	bool "TP HIMAX_IC enable or not for OPPO"
	---help---
	say Y to enable driver for Touchpanel using HIMAX_IC

	
source "drivers/input/touchscreen/oppo_touchscreen/util_interface/Kconfig"

if TOUCHPANEL_SYNAPTICS
source "drivers/input/touchscreen/oppo_touchscreen/Synaptics/Kconfig"
endif

if TOUCHPANEL_NOVA
source "drivers/input/touchscreen/oppo_touchscreen/Novatek/Kconfig"
endif

if TOUCHPANEL_HIMAX
source "drivers/input/touchscreen/oppo_touchscreen/Himax/Kconfig"
endif
```
